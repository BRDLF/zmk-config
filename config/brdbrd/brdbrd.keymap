/*
 * Copyright (c) 2022 The ZMK Contributors
 *
 * SPDX-License-Identifier: MIT
 */

#include <behaviors.dtsi>
#include <dt-bindings/zmk/keys.h>
#include <dt-bindings/zmk/bt.h>

#define DEFAULT  0
#define LOWER    1
#define RAISE    2
#define NAV      3
#define NUM      4
#define MOD      5

/ {
    keymap {
        compatible = "zmk,keymap";

        default_layer {
            bindings = <
    &kp GRAVE &kp N1    &kp N2   &kp N3    &kp N4      &kp N5     &kp N6    &kp N7     &kp N8    &kp N9    &kp N0   &tog NAV  &kp KP_SLASH &kp KP_MULTIPLY &kp KP_MINUS
    &kp ESC   &kp Q     &kp W    &kp E     &kp R       &kp T      &kp Y     &kp U      &kp I     &kp O     &kp P    &kp ENTER &kp KP_N7    &kp KP_N8       &kp KP_N9
    &kp TAB   &kp A     &kp S    &kp D     &kp F       &kp G      &kp H     &kp J      &kp K     &kp L     &kp SEMI &kp SQT   &kp KP_N4    &kp KP_N5       &kp KP_N6
    &kp LSHFT &kp Z     &kp X    &kp C     &kp V       &kp B      &kp N     &kp M      &kp COMMA &kp DOT   &kp FSLH &kp SHIFT &kp KP_N1    &kp KP_N2       &kp KP_N3
    &kp LCTRL &kp LGUI  &kp LALT &kp BSLH  &mo LOWER   &kp SPACE  &kp BSPC  &mo RAISE  &kp DEL   &kp RCTRL &kp BSLH &tog NUM  &kp KP_N0    &kp KP_DOT      &kp KP_PLUS
            >;
        };

        lower {
            bindings = <
    &trans    &trans    &trans   &trans   &trans      &trans     &trans    &trans      &trans    &trans    &trans   &trans    &trans    &trans  &trans
    &trans    &trans    &trans   &trans   &trans      &trans     &trans    &trans      &trans    &trans    &trans   &trans    &trans    &trans  &trans
    &trans    &trans    &trans   &trans   &trans      &trans     &trans    &trans      &trans    &trans    &trans   &trans    &trans    &trans  &trans
    &trans    &trans    &trans   &trans   &trans      &trans     &trans    &trans      &trans    &trans    &trans   &trans    &trans    &trans  &trans
    &trans    &trans    &trans   &trans   &trans      &trans     &trans    &trans      &trans    &trans    &trans   &trans    &trans    &trans  &trans
            >;
        };

        raise {
            bindings = <
    &trans    &trans    &trans   &trans   &trans      &trans     &trans    &trans      &trans    &trans    &trans   &tog NAV  &trans    &trans  &trans
    &trans    &trans    &trans   &kp LBKT &kp RBKT    &trans     &trans    &trans      &trans    &trans    &trans   &trans    &trans    &trans  &trans
    &kp PIPE  &trans    &trans   &kp LPAR &kp RPAR    &trans     &trans    &trans      &kp UP    &trans    &trans   &trans    &trans    &trans  &trans
    &trans    &trans    &trans   &kp LBRC &kp RBRC    &trans     &trans    &kp LEFT    &kp DOWN  &kp RIGHT &trans   &trans    &trans    &trans  &trans
    &trans    &trans    &trans   &trans   &trans      &kp SPACE  &kp BSPC  &trans      &trans    &trans    &trans   &tog NUM  &trans    &trans  &trans
            >;
        };
        
        nav {
            bindings = <
    &trans     &trans       &trans       &trans       &trans       &trans       &trans    &trans    &trans     &trans     &trans   &tog NAV &kp KP_SLASH &kp KP_MULTIPLY &kp KP_MINUS
    &trans     &trans       &trans       &trans       &trans       &trans       &trans    &trans    &trans     &trans     &trans   &trans   &kp KP_N7    &kp KP_N8       &kp KP_N9
    &trans     &trans       &trans       &trans       &trans       &trans       &trans    &trans    &trans     &trans     &trans   &trans   &kp KP_N4    &kp KP_N5       &kp KP_N6
    &trans     &trans       &trans       &trans       &trans       &trans       &trans    &trans    &trans     &trans     &trans   &trans   &kp KP_N1    &kp KP_N2       &kp KP_N3
    &trans     &trans       &trans       &trans       &trans       &trans       &trans    &trans    &trans     &trans     &trans   &tog NUM &kp KP_N0    &kp KP_DOT      &kp KP_PLUS
            >;
        };
        
        num {
            bindings = <
    &trans     &trans       &trans       &trans       &trans       &trans       &trans    &trans    &trans     &trans     &trans   &tog NAV &kp KP_SLASH &kp KP_MULTIPLY &kp KP_MINUS
    &trans     &trans       &trans       &trans       &trans       &trans       &trans    &trans    &trans     &trans     &trans   &trans   &kp KP_N7    &kp KP_N8       &kp KP_N9
    &trans     &trans       &trans       &trans       &trans       &trans       &trans    &trans    &trans     &trans     &trans   &trans   &kp KP_N4    &kp KP_N5       &kp KP_N6
    &trans     &trans       &trans       &trans       &trans       &trans       &trans    &trans    &trans     &trans     &trans   &trans   &kp KP_N1    &kp KP_N2       &kp KP_N3
    &trans     &trans       &trans       &trans       &trans       &trans       &trans    &trans    &trans     &trans     &trans   &tog NUM &kp KP_N0    &kp KP_DOT      &kp KP_PLUS
            >;
        };
    };
    
        mod {
            bindings = <
    &trans     &trans       &trans       &trans       &trans       &trans       &trans    &trans    &trans     &trans     &trans   &tog NAV &kp KP_SLASH &kp KP_MULTIPLY &kp KP_MINUS
    &trans     &trans       &trans       &trans       &trans       &trans       &trans    &trans    &trans     &trans     &trans   &trans   &kp KP_N7    &kp KP_N8       &kp KP_N9
    &trans     &trans       &trans       &trans       &trans       &trans       &trans    &trans    &trans     &trans     &trans   &trans   &kp KP_N4    &kp KP_N5       &kp KP_N6
    &trans     &trans       &trans       &trans       &trans       &trans       &trans    &trans    &trans     &trans     &trans   &trans   &kp KP_N1    &kp KP_N2       &kp KP_N3
    &trans     &trans       &trans       &trans       &trans       &trans       &trans    &trans    &trans     &trans     &trans   &tog NUM &kp KP_N0    &kp KP_DOT      &kp KP_PLUS
            >;
        };
    };
};

/ {
    conditional_layers {
        compatible = "zmk,conditional_layers";
        tri_layer {
            if-layers = <LOWER RAISE>;
            then-layer = <MOD>;
        };
    };
};

/ {
    combos {
        compatible = "zmk,combos";
        combo_caps {
            timeout_ms =
            bindings = <&kp CAPSLOCK>
